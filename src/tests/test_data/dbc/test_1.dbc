VERSION ""

NS_ :

BS_:

BU_: BMS

BO_ 58 BMS1: 8 BMS
 SG_ ChargeRelay : 1|1@1+ (1,0) [0|0] "" Vector__XXX
 SG_ DischargeRelay : 0|1@1+ (1,0) [0|0] "" Vector__XXX
